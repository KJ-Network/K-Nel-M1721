## drivers/input/fingerprint/Kconfig
```kconfig
config INPUT_FINGERPRINT
	tristate "Fingerprint driver support"
	help
	  Say Y here to enable fingerprint driver support.

config FINGERPRINT_GOODIX
	tristate "Goodix fingerprint support"
	help
	  Say Y here to enable Goodix fingerprint driver support.
```

## drivers/platform/meizu/Kconfig
```kconfig
# Meizu configuration options
config MEIZU_HW
	bool "IOCTL for Meizu libs"
	help
	  Enable kernel meizu_hw driver to get HW info
```

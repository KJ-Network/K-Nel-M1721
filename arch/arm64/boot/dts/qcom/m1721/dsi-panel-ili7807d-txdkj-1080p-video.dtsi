/* Copyright (c) 2012-2015, The Linux Foundation. All rights reserved.
 *
 * This program is free software; you can redistribute it and/or modify
 * it under the terms of the GNU General Public License version 2 and
 * only version 2 as published by the Free Software Foundation.
 *
 * This program is distributed in the hope that it will be useful,
 * but WITHOUT ANY WARRANTY; without even the implied warranty of
 * MERCHANTABILITY or FITNESS FOR A PARTICULAR PURPOSE.  See the
 * GNU General Public License for more details.
 */

&mdss_mdp {
	dsi_ili7807d_txdkj_1080p: qcom,mdss_dsi_ili7807d_txdkj_1080p_video {
    qcom,mdss-dsi-panel-name = "nili7807d txdkj 1080p video mode dsi panel";
    qcom,mdss-dsi-panel-type = "dsi_video_mode";
    qcom,mdss-dsi-panel-destination = "display_1";
    qcom,mdss-dsi-panel-framerate = <0x3c>;
    qcom,mdss-dsi-virtual-channel-id = <0x0>;
    qcom,mdss-dsi-stream = <0x0>;
    qcom,mdss-dsi-panel-width = <0x438>;
    qcom,mdss-dsi-panel-height = <0x780>;
    qcom,mdss-dsi-h-front-porch = <0x50>;
    qcom,mdss-dsi-h-back-porch = <0x58>;
    qcom,mdss-dsi-h-pulse-width = <0x1c>;
    qcom,mdss-dsi-h-sync-skew = <0x0>;
    qcom,mdss-dsi-v-back-porch = <0x10>;
    qcom,mdss-dsi-v-front-porch = <0x18>;
    qcom,mdss-dsi-v-pulse-width = <0x8>;
    qcom,mdss-dsi-h-left-border = <0x0>;
    qcom,mdss-dsi-h-right-border = <0x0>;
    qcom,mdss-dsi-v-top-border = <0x0>;
    qcom,mdss-dsi-v-bottom-border = <0x0>;
    qcom,mdss-dsi-bpp = <0x24>;
    qcom,mdss-dsi-color-order = "rgb_swap_rgb";
    qcom,mdss-dsi-underflow-color = <0xff>;
    qcom,mdss-dsi-border-color = <0x0>;
    qcom,mdss-dsi-on-command = <0x39010000 0x4ff 0x78070139 0x1000000 0x24211 0x39010000 0x245 0x19390100 0x2 0x46283901 0x0 0x24a1239 0x1000000 0x24b12 0x39010000 0x250 0x5a390100 0x2 0x515a3901 0x0 0x2a20139 0x1000000 0x2a316 0x39010000 0x4ff 0x78070139 0x1000000 0x22206 0x39010000 0x236 0x390100 0x2 0x63043901 0x0 0x2640839 0x1000000 0x26c45 0x39010000 0x26d 0x390100 0x2 0x5a333901 0x0 0x4ff7807 0x6390100 0x2 0x433901 0x0 0x2011239 0x1000000 0x20243 0x39010000 0x203 0x43390100 0x2 0x4033901 0x0 0x2051239 0x1000000 0x20608 0x39010000 0x207 0xa390100 0x2 0x8833901 0x0 0x2090239 0x1000000 0x20a30 0x39010000 0x20b 0x10390100 0x2 0xc083901 0x0 0x20d0839 0x1000000 0x20e00 0x39010000 0x20f 0x390100 0x2 0x10003901 0x0 0x2110039 0x1000000 0x21200 0x39010000 0x213 0x390100 0x2 0x14843901 0x0 0x2158439 0x1000000 0x23108 0x39010000 0x232 0x1390100 0x2 0x33003901 0x0 0x2341139 0x1000000 0x23513 0x39010000 0x236 0x26390100 0x2 0x37223901 0x0 0x2380239 0x1000000 0x2390c 0x39010000 0x23a 0x2390100 0x2 0x3b023901 0x0 0x23c0239 0x1000000 0x23d02 0x39010000 0x23e 0x28390100 0x2 0x3f293901 0x0 0x2402a39 0x1000000 0x24108 0x39010000 0x242 0x1390100 0x2 0x43003901 0x0 0x2441039 0x1000000 0x24512 0x39010000 0x246 0x26390100 0x2 0x47223901 0x0 0x2480239 0x1000000 0x2490c 0x39010000 0x24a 0x2390100 0x2 0x4b023901 0x0 0x24c0239 0x1000000 0x24d02 0x39010000 0x24e 0x28390100 0x2 0x4f293901 0x0 0x2502a39 0x1000000 0x2610c 0x39010000 0x262 0x1390100 0x2 0x63003901 0x0 0x2641239 0x1000000 0x26510 0x39010000 0x266 0x26390100 0x2 0x67223901 0x0 0x2680239 0x1000000 0x26908 0x39010000 0x26a 0x2390100 0x2 0x6b023901 0x0 0x26c0239 0x1000000 0x26d02 0x39010000 0x26e 0x28390100 0x2 0x6f293901 0x0 0x2702a39 0x1000000 0x2710c 0x39010000 0x272 0x1390100 0x2 0x73003901 0x0 0x2741339 0x1000000 0x27511 0x39010000 0x276 0x26390100 0x2 0x77223901 0x0 0x2780239 0x1000000 0x27908 0x39010000 0x27a 0x2390100 0x2 0x7b023901 0x0 0x27c0239 0x1000000 0x27d02 0x39010000 0x27e 0x28390100 0x2 0x7f293901 0x0 0x2802a39 0x1000000 0x2d001 0x39010000 0x2d1 0x1390100 0x2 0xd2103901 0x0 0x2d30039 0x1000000 0x2d400 0x39010000 0x2d5 0x390100 0x2 0xd6003901 0x0 0x2d70039 0x1000000 0x2d800 0x39010000 0x2d9 0x390100 0x2 0xda003901 0x0 0x2db4739 0x1000000 0x2dc02 0x39010000 0x2dd 0x55390100 0x2 0x96803901 0x0 0x2973339 0x1000000 0x2a010 0x39010000 0x2a1 0x390100 0x2 0xa2083901 0x0 0x2a31e39 0x1000000 0x2a700 0x39010000 0x2a6 0x32390100 0x2 0xa7033901 0x0 0x2ae1439 0x1000000 0x2e355 0x39010000 0x2e5 0x80390100 0x2 0xb2043901 0x0 0x2b30439 0x1000000 0x4ff78 0x7023901 0x0 0x2000039 0x1000000 0x2010f 0x39010000 0x202 0x390100 0x2 0x3313901 0x0 0x2040039 0x1000000 0x20564 0x39010000 0x206 0x390100 0x2 0x78a3901 0x0 0x2080039 0x1000000 0x209a7 0x39010000 0x20a 0x390100 0x2 0xbc03901 0x0 0x20c0039 0x1000000 0x20dd5 0x39010000 0x20e 0x390100 0x2 0xfe73901 0x0 0x2100039 0x1000000 0x211f8 0x39010000 0x212 0x1390100 0x2 0x132d3901 0x0 0x2140139 0x1000000 0x21555 0x39010000 0x216 0x1390100 0x2 0x178f3901 0x0 0x2180139 0x1000000 0x219b9 0x39010000 0x21a 0x1390100 0x2 0x1bf63901 0x0 0x21c0239 0x1000000 0x21d26 0x39010000 0x21e 0x2390100 0x2 0x1f273901 0x0 0x2200239 0x1000000 0x22155 0x39010000 0x222 0x2390100 0x2 0x238c3901 0x0 0x2240239 0x1000000 0x225b3 0x39010000 0x226 0x2390100 0x2 0x27e93901 0x0 0x2280339 0x1000000 0x2290d 0x39010000 0x22a 0x3390100 0x2 0x2b3b3901 0x0 0x22c0339 0x1000000 0x22d49 0x39010000 0x22e 0x3390100 0x2 0x2f583901 0x0 0x2300339 0x1000000 0x23169 0x39010000 0x232 0x3390100 0x2 0x337d3901 0x0 0x2340339 0x1000000 0x23594 0x39010000 0x236 0x3390100 0x2 0x37b13901 0x0 0x2380339 0x1000000 0x239de 0x39010000 0x23a 0x3390100 0x2 0x3be63901 0x0 0x23c0039 0x1000000 0x23d0f 0x39010000 0x23e 0x390100 0x2 0x3f313901 0x0 0x2400039 0x1000000 0x24164 0x39010000 0x242 0x390100 0x2 0x438a3901 0x0 0x2440039 0x1000000 0x245a7 0x39010000 0x246 0x390100 0x2 0x47c03901 0x0 0x2480039 0x1000000 0x249d5 0x39010000 0x24a 0x390100 0x2 0x4be73901 0x0 0x24c0039 0x1000000 0x24df8 0x39010000 0x24e 0x1390100 0x2 0x4f2d3901 0x0 0x2500139 0x1000000 0x25155 0x39010000 0x252 0x1390100 0x2 0x538f3901 0x0 0x2540139 0x1000000 0x255b9 0x39010000 0x256 0x1390100 0x2 0x57f63901 0x0 0x2580239 0x1000000 0x25926 0x39010000 0x25a 0x2390100 0x2 0x5b273901 0x0 0x25c0239 0x1000000 0x25d55 0x39010000 0x25e 0x2390100 0x2 0x5f8c3901 0x0 0x2600239 0x1000000 0x261b3 0x39010000 0x262 0x2390100 0x2 0x63e93901 0x0 0x2640339 0x1000000 0x2650d 0x39010000 0x266 0x3390100 0x2 0x673b3901 0x0 0x2680339 0x1000000 0x26949 0x39010000 0x26a 0x3390100 0x2 0x6b583901 0x0 0x26c0339 0x1000000 0x26d69 0x39010000 0x26e 0x3390100 0x2 0x6f7d3901 0x0 0x2700339 0x1000000 0x27194 0x39010000 0x272 0x3390100 0x2 0x73b13901 0x0 0x2740339 0x1000000 0x275de 0x39010000 0x276 0x3390100 0x2 0x77e63901 0x0 0x2780139 0x1000000 0x27901 0x39010000 0x4ff 0x78070339 0x1000000 0x20000 0x39010000 0x201 0x21390100 0x2 0x2003901 0x0 0x2034339 0x1000000 0x20400 0x39010000 0x205 0x75390100 0x2 0x6003901 0x0 0x2079939 0x1000000 0x20800 0x39010000 0x209 0xb5390100 0x2 0xa003901 0x0 0x20bcd39 0x1000000 0x20c00 0x39010000 0x20d 0xe1390100 0x2 0xe003901 0x0 0x20ff439 0x1000000 0x21001 0x39010000 0x211 0x4390100 0x2 0x12013901 0x0 0x2133739 0x1000000 0x21401 0x39010000 0x215 0x5d390100 0x2 0x16013901 0x0 0x2179539 0x1000000 0x21801 0x39010000 0x219 0xbe390100 0x2 0x1a013901 0x0 0x21bfa39 0x1000000 0x21c02 0x39010000 0x21d 0x2a390100 0x2 0x1e023901 0x0 0x21f2b39 0x1000000 0x22002 0x39010000 0x221 0x58390100 0x2 0x22023901 0x0 0x2239039 0x1000000 0x22402 0x39010000 0x225 0xb6390100 0x2 0x26023901 0x0 0x227ec39 0x1000000 0x22803 0x39010000 0x229 0x10390100 0x2 0x2a033901 0x0 0x22b3d39 0x1000000 0x22c03 0x39010000 0x22d 0x4b390100 0x2 0x2e033901 0x0 0x22f5a39 0x1000000 0x23003 0x39010000 0x231 0x6b390100 0x2 0x32033901 0x0 0x2337d39 0x1000000 0x23403 0x39010000 0x235 0x92390100 0x2 0x36033901 0x0 0x237ac39 0x1000000 0x23803 0x39010000 0x239 0xd2390100 0x2 0x3a033901 0x0 0x23be639 0x1000000 0x23c00 0x39010000 0x23d 0x21390100 0x2 0x3e003901 0x0 0x23f4339 0x1000000 0x24000 0x39010000 0x241 0x75390100 0x2 0x42003901 0x0 0x2439939 0x1000000 0x24400 0x39010000 0x245 0xb5390100 0x2 0x46003901 0x0 0x247cd39 0x1000000 0x24800 0x39010000 0x249 0xe1390100 0x2 0x4a003901 0x0 0x24bf439 0x1000000 0x24c01 0x39010000 0x24d 0x4390100 0x2 0x4e013901 0x0 0x24f3739 0x1000000 0x25001 0x39010000 0x251 0x5d390100 0x2 0x52013901 0x0 0x2539539 0x1000000 0x25401 0x39010000 0x255 0xbe390100 0x2 0x56013901 0x0 0x257fa39 0x1000000 0x25802 0x39010000 0x259 0x2a390100 0x2 0x5a023901 0x0 0x25b2b39 0x1000000 0x25c02 0x39010000 0x25d 0x58390100 0x2 0x5e023901 0x0 0x25f9039 0x1000000 0x26002 0x39010000 0x261 0xb6390100 0x2 0x62023901 0x0 0x263ec39 0x1000000 0x26403 0x39010000 0x265 0x10390100 0x2 0x66033901 0x0 0x2673d39 0x1000000 0x26803 0x39010000 0x269 0x4b390100 0x2 0x6a033901 0x0 0x26b5a39 0x1000000 0x26c03 0x39010000 0x26d 0x6b390100 0x2 0x6e033901 0x0 0x26f7d39 0x1000000 0x27003 0x39010000 0x271 0x92390100 0x2 0x72033901 0x0 0x273ac39 0x1000000 0x27403 0x39010000 0x275 0xd2390100 0x2 0x76033901 0x0 0x277e639 0x1000000 0x27801 0x39010000 0x279 0x1390100 0x4 0xff780704 0x39010000 0x200 0x390100 0x2 0x10c3901 0x0 0x2020039 0x1000000 0x20348 0x39010000 0x204 0x390100 0x2 0x5853901 0x0 0x2060039 0x1000000 0x207ab 0x39010000 0x208 0x390100 0x2 0x9c83901 0x0 0x20a0039 0x1000000 0x20bdf 0x39010000 0x20c 0x390100 0x2 0xdf33901 0x0 0x20e0139 0x1000000 0x20f05 0x39010000 0x210 0x1390100 0x2 0x11143901 0x0 0x2120139 0x1000000 0x21344 0x39010000 0x214 0x1390100 0x2 0x15693901 0x0 0x2160139 0x1000000 0x2179e 0x39010000 0x218 0x1390100 0x2 0x19c53901 0x0 0x21a0139 0x1000000 0x21bfe 0x39010000 0x21c 0x2390100 0x2 0x1d2c3901 0x0 0x21e0239 0x1000000 0x21f2d 0x39010000 0x220 0x2390100 0x2 0x215a3901 0x0 0x2220239 0x1000000 0x22391 0x39010000 0x224 0x2390100 0x2 0x25b83901 0x0 0x2260239 0x1000000 0x227ed 0x39010000 0x228 0x3390100 0x2 0x29113901 0x0 0x22a0339 0x1000000 0x22b3e 0x39010000 0x22c 0x3390100 0x2 0x2d4b3901 0x0 0x22e0339 0x1000000 0x22f5a 0x39010000 0x230 0x3390100 0x2 0x316b3901 0x0 0x2320339 0x1000000 0x2337d 0x39010000 0x234 0x3390100 0x2 0x35933901 0x0 0x2360339 0x1000000 0x237ae 0x39010000 0x238 0x3390100 0x2 0x39d13901 0x0 0x23a0339 0x1000000 0x23be6 0x39010000 0x23c 0x390100 0x2 0x3d0c3901 0x0 0x23e0039 0x1000000 0x23f48 0x39010000 0x240 0x390100 0x2 0x41853901 0x0 0x2420039 0x1000000 0x243ab 0x39010000 0x244 0x390100 0x2 0x45c83901 0x0 0x2460039 0x1000000 0x247df 0x39010000 0x248 0x390100 0x2 0x49f33901 0x0 0x24a0139 0x1000000 0x24b05 0x39010000 0x24c 0x1390100 0x2 0x4d143901 0x0 0x24e0139 0x1000000 0x24f44 0x39010000 0x250 0x1390100 0x2 0x51693901 0x0 0x2520139 0x1000000 0x2539e 0x39010000 0x254 0x1390100 0x2 0x55c53901 0x0 0x2560139 0x1000000 0x257fe 0x39010000 0x258 0x2390100 0x2 0x592c3901 0x0 0x25a0239 0x1000000 0x25b2d 0x39010000 0x25c 0x2390100 0x2 0x5d5a3901 0x0 0x25e0239 0x1000000 0x25f91 0x39010000 0x260 0x2390100 0x2 0x61b83901 0x0 0x2620239 0x1000000 0x263ed 0x39010000 0x264 0x3390100 0x2 0x65113901 0x0 0x2660339 0x1000000 0x2673e 0x39010000 0x268 0x3390100 0x2 0x694b3901 0x0 0x26a0339 0x1000000 0x26b5a 0x39010000 0x26c 0x3390100 0x2 0x6d6b3901 0x0 0x26e0339 0x1000000 0x26f7d 0x39010000 0x270 0x3390100 0x2 0x71933901 0x0 0x2720339 0x1000000 0x273ae 0x39010000 0x274 0x3390100 0x2 0x75d13901 0x0 0x2760339 0x1000000 0x277e6 0x39010000 0x278 0x1390100 0x2 0x79013901 0x0 0x4ff7807 0x390100 0x2 0x36c00501 0x7800 0x2110005 0x1000000 0x229c0>;
    qcom,mdss-dsi-off-command = [05 01 00 00 32 00 02 28 c0 05 01 00 00 78 00 02 10 00 39 01 00 00 00 00 04 ff 78 07 01 39 01 00 00 78 00 02 58 01];
    qcom,mdss-dsi-on-command-state = "dsi_lp_mode";
    qcom,mdss-dsi-off-command-state = "dsi_lp_mode";
    qcom,mdss-dsi-h-sync-pulse = <0x1>;
    qcom,mdss-dsi-traffic-mode = "burst_mode";
    qcom,mdss-dsi-lane-map = "lane_map_0123";
    qcom,mdss-dsi-bllp-eof-power-mode;
    qcom,mdss-dsi-bllp-power-mode;
    qcom,mdss-dsi-lp11-init;
    qcom,mdss-dsi-lane-0-state;
    qcom,mdss-dsi-lane-1-state;
    qcom,mdss-dsi-lane-2-state;
    qcom,mdss-dsi-lane-3-state;
    qcom,mdss-dsi-panel-timings = <0xeb382600 0x6a6c2c3c 0x2f030400>;
    qcom,mdss-dsi-t-clk-post = <0x2>;
    qcom,mdss-dsi-t-clk-pre = <0x2b>;
    qcom,mdss-dsi-bl-min-level = <0x1>;
    qcom,mdss-dsi-bl-max-level = <0xfff>;
    qcom,mdss-dsi-dma-trigger = "trigger_sw";
    qcom,mdss-dsi-mdp-trigger = "none";
    qcom,mdss-dsi-bl-pmic-control-type = "bl_ctrl_wled";
    qcom,mdss-dsi-reset-sequence = <0x1 0x1 0x0 0x5 0x1 0x32>;
    qcom,esd-check-enabled;
    qcom,cont-splash-enabled;
};
};

/*
 * Copyright (c) 2017, The Linux Foundation. All rights reserved.
 *
 * This program is free software; you can redistribute it and/or modify
 * it under the terms of the GNU General Public License version 2 and
 * only version 2 as published by the Free Software Foundation.
 *
 * This program is distributed in the hope that it will be useful,
 * but WITHOUT ANY WARRANTY; without even the implied warranty of
 * MERCHANTABILITY or FITNESS FOR A PARTICULAR PURPOSE.  See the
 * GNU General Public License for more details.
 */

#include "msm8953-audio-m1721.dtsi"
#include "msm8953-general-m1721.dtsi"
#include "msm8953-display-m1721.dtsi"
#include "msm8953-camera-sensor-qrd-m1721.dtsi"
#include "msm8953-pinctrl-m1721.dtsi"
#include "msm8953-memory-m1721.dtsi"
